// Copyright 2022 Manna Harbour
// https://github.com/manna-harbour/miryoku

/ {
  behaviors {
    u_mt: u_mt {
      compatible = "zmk,behavior-hold-tap";
      #binding-cells = <2>;
      tapping-term-ms = <U_TAPPING_TERM>;
      require-prior-idle-ms = <U_IDLE_TERM>;
      quick-tap-ms = <U_QUICK_TERM>;
      flavor = "balanced";
      bindings = <&kp>, <&kp>;
    };
    u_lt: u_lt {
      compatible = "zmk,behavior-hold-tap";
      #binding-cells = <2>;
      tapping-term-ms = <U_TAPPING_TERM>;
      require-prior-idle-ms = <U_IDLE_TERM>;
      quick-tap-ms = <U_QUICK_TERM>;
      flavor = "balanced";
      bindings = <&mo>, <&kp>;
    };
  };
};
